## drivers/sensor/adxl345/Kconfig
```kconfig
menuconfig ADXL345
	bool "ADXL345 sensor"
	depends on (I2C && HAS_DTS_I2C) || (SPI && HAS_DTS_SPI)
	help
	 Enable driver for ADXL345 I2C-based (SPI not supported now) acceleration sensor.

if ADXL345

choice ADXL345_BUS_TYPE
	prompt "Interface type"
	help
	  Select interface the digital interface type for the ADXL345

config ADXL345_I2C
	depends on I2C
	bool "I2C Interface"

endchoice

endif
```

## drivers/sensor/bh1730fvc/Kconfig
```kconfig
menuconfig BH1730FVC
	bool "BH1730FVC sensor"
	depends on I2C && HAS_DTS_I2C
	help
	 Enable driver for BH1730FVC I2C-based lux sensor

if BH1730FVC

choice
	prompt "Trigger mode"
	default FV1730FVC_TRIGGER_NONE
	help
	  Specify the type of triggering used by the driver.

config FV1730FVC_TRIGGER_NONE
	bool "No trigger"

config FV1730FVC_TRIGGER_GLOBAL_THREAD
	bool "Use global thread"
	depends on GPIO
	select FV1730FVC_TRIGGER

config FV1730FVC_TRIGGER_OWN_THREAD
	bool "Use own thread"
	depends on GPIO
	select FV1730FVC_TRIGGER

endchoice

config FV1730FVC_TRIGGER
	bool

endif
```

## dts/bindings/sensor/rohm,bh1730fvc.yaml
```yaml
#
# Copyright (c) 2018 Analog Devices Inc.
#
# SPDX-License-Identifier: Apache-2.0
#

title: BH1730FVC I2C light sensor

description: >
    This is a representation of the BH1730FVC lux sensor

inherits:
    !include i2c-device.yaml

properties:
    compatible:
      constraint: "rohm,bh1730fvc"

    int1-gpios:
      type: compound
      category: optional
```

## soc/arm/st_stm32/stm32l0/Kconfig.defconfig.stm32l051xx
```kconfig
# Kconfig - ST Microelectronics STM32L051X8 MCU
#
# Copyright (c) 2018 Anthony Kreft <anthony.kreft@gmail.com>
# Copyright (c) 2019 George Hilliard <thirtythreeforty@gmail.com>
#
# SPDX-License-Identifier: Apache-2.0
#

if SOC_STM32L051XX

config SOC
	string
	default "stm32l051xx"

config NUM_IRQS
	int
	default 32

if GPIO_STM32

config GPIO_STM32_PORTD
	default y

config GPIO_STM32_PORTH
	default y

endif # GPIO_STM32

endif # SOC_STM32L051XX
```
